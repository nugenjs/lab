## iot/waterbed/sdkconfig.defaults
```kconfig
CONFIG_BT_ENABLED=y
CONFIG_BT_BLE_50_FEATURES_SUPPORTED=n
CONFIG_BT_BLE_42_FEATURES_SUPPORTED=y
CONFIG_ESP_DEFAULT_CPU_FREQ_MHZ_80=y
CONFIG_FREERTOS_HZ=1000
CONFIG_DIAG_USE_EXTERNAL_LOG_WRAP=y
```

## microcontrol/esp32/03espIdfArduinoLib copy/sdkconfig.defaults
```kconfig
# ESP-IDF configuration for ESP32-C3

#
# Serial flasher config
#
CONFIG_ESPTOOLPY_FLASHMODE_QIO=y
CONFIG_ESPTOOLPY_FLASHFREQ_80M=y
CONFIG_ESPTOOLPY_FLASHSIZE_4MB=y

#
# Partition Table
#
CONFIG_PARTITION_TABLE_CUSTOM=y
CONFIG_PARTITION_TABLE_CUSTOM_FILENAME="partitions.csv"

#
# Component config
#

#
# ESP32C3-Specific
#
CONFIG_ESP_DEFAULT_CPU_FREQ_MHZ_160=y

#
# Driver configurations
#
CONFIG_GPTIMER_ENABLE_DEBUG_LOG=y

#
# FreeRTOS
#
CONFIG_FREERTOS_HZ=1000

#
# Log output
#
CONFIG_LOG_DEFAULT_LEVEL_INFO=y

#
# LWIP
#
CONFIG_LWIP_LOCAL_HOSTNAME="esp32c3"

#
# Serial console configuration
#
CONFIG_ESP_CONSOLE_UART_DEFAULT=y
CONFIG_ESP_CONSOLE_UART_NUM=0
CONFIG_ESP_CONSOLE_UART_BAUDRATE_115200=y

#
# USB Serial/JTAG Controller
#
CONFIG_ESP_CONSOLE_USB_SERIAL_JTAG=y
```
